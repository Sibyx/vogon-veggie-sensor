## components/sensors/Kconfig.projbuild
```kconfig
menu "Sensors Configuration"
    config SENSORS_I2C_MASTER_SCL
        int "SCL GPIO Number"
        default 5 if IDF_TARGET_ESP8266
        default 6 if IDF_TARGET_ESP32C3
        default 19 if IDF_TARGET_ESP32 || IDF_TARGET_ESP32S2 || IDF_TARGET_ESP32S3
        help
            GPIO number for I2C Master clock line.

    config SENSORS_I2C_MASTER_SDA
        int "SDA GPIO Number"
        default 4 if IDF_TARGET_ESP8266
        default 5 if IDF_TARGET_ESP32C3
        default 18 if IDF_TARGET_ESP32 || IDF_TARGET_ESP32S2 || IDF_TARGET_ESP32S3
        help
            GPIO number for I2C Master data line.

    config SENSORS_BPM280_SLEEP_PERIOD
        int "BPM280 sleep time (min)"
        default 10
        help
            Time in minutes between measurement of BPM280.

    config SENSORS_VCNL4040_SLEEP_PERIOD
        int "VCNL4040 sleep time (min)"
        default 10
        help
            Time in minutes between measurement of VCNL4040.

    config SENSORS_SEN0605_SLEEP_PERIOD
        int "SEN0605 sleep time (min)"
        default 60
        help
            Time in minutes between measurement of SEN0605.

    config SENSORS_MOISTURE_SLEEP_PERIOD
        int "MOISTURE sleep time (min)"
        default 60
        help
            Time in minutes between measurement of moisture.
endmenu
```
